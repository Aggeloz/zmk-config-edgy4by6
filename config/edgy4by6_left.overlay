// Left side overlay for edgy4by6 split keyboard
// 6 columns x 5 rows

#include "edgy4by6.dtsi"

&kscan {
    // Column pins for the LEFT side (6 columns)
    col-gpios
        = <&gpio0 24 GPIO_ACTIVE_HIGH>  // P0.24 - Column 0
        , <&gpio1  0 GPIO_ACTIVE_HIGH>  // P1.00 - Column 1
        , <&gpio0 11 GPIO_ACTIVE_HIGH>  // P0.11 - Column 2
        , <&gpio1  4 GPIO_ACTIVE_HIGH>  // P1.04 - Column 3
        , <&gpio1  6 GPIO_ACTIVE_HIGH>  // P1.06 - Column 4
        , <&gpio0  9 GPIO_ACTIVE_HIGH>  // P0.09 - Column 5
        ;
};
