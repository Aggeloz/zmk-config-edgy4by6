## boards/shields/edgy4by6/Kconfig.shield
```kconfig
config SHIELD_EDGY4BY6_LEFT
    def_bool $(shields_list_contains,edgy4by6_left)

config SHIELD_EDGY4BY6_RIGHT
    def_bool $(shields_list_contains,edgy4by6_right)
```

## config/keyboards/edgy4by6/Kconfig.defconfig
```kconfig
if SHIELD_EDGY4BY6_LEFT

config ZMK_KEYBOARD_NAME
    default "edgy4by6"

config ZMK_SPLIT_ROLE_CENTRAL
    default y

endif # SHIELD_EDGY4BY6_LEFT

if SHIELD_EDGY4BY6_LEFT || SHIELD_EDGY4BY6_RIGHT

config ZMK_SPLIT
    default y

endif # SHIELD_EDGY4BY6_LEFT || SHIELD_EDGY4BY6_RIGHT
```
